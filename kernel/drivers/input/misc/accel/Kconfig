## kernel/drivers/input/misc/accel/Kconfig
```kconfig
#
# inv-bma250 accelerometer input device
#

config INV_BMA250
    tristate "Invensense Bosch BMA250 accelerometer input device driver"
    depends on I2C && SYSFS && INPUT
    default n
    help
      This driver supports the Bosch BMA250 accelerometer.
      This driver can be built as a module. The module will be called
      inv-bma250.
```

## kernel/drivers/input/touchscreen/ft5x0x_ts/Kconfig
```kconfig
config TOUCHSCREEN_FT5X0X
	tristate "FT5X0X I2C Touchscreen"
	depends on I2C
	default n
	help
	if unsure, say N.
```

## modules/drivers/input/Kconfig
```kconfig
source "drivers/external_drivers/drivers/input/touchscreen/Kconfig"
source "drivers/external_drivers/drivers/input/misc/Kconfig"
source "drivers/external_drivers/drivers/input/touchscreen/elan/Kconfig"
source "drivers/external_drivers/drivers/input/touchscreen/s7805/Kconfig"
source "drivers/external_drivers/drivers/input/touchscreen/ft5416/Kconfig"
```

## modules/drivers/input/touchscreen/elan/Kconfig
```kconfig
config TOUCHSCREEN_ELAN
	tristate "elan ektf2k touch controller"
	depends on I2C
	help
	  Say Y here if you have a elan ektf2k I2C touchscreen
	  connected to your system.

	  If unsure, say N.

	  To compile this driver as a module, choose M here: the
	  module will be called ektf2k.
```

## modules/drivers/input/touchscreen/ft5416/Kconfig
```kconfig
config TOUCHSCREEN_FOCALTECH_5416_TOUCH
	tristate "focaltech 5416 touch controller"
	depends on I2C
	help
	  Say Y here if you have a focaltech 5416 I2C touch controller
	  connected to your system.

	  If unsure, say N.

	  To compile this driver as a module, choose M here: the
	  module will be called ft5416_touch.
```
